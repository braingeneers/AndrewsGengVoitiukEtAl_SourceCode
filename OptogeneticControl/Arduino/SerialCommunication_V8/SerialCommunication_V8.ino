
/****************************************************************************** 
MCP4725 Thorlabs Waveforms
Braingeneers
03/04/2022 

Description: 
This sketch takes data from a lookup table to provide  waveforms to 
be generated by the MCP4725 DAC. 
DAC // -32,768 to 32,767
*******************************************************************************/


#include "SerialTransfer.h"
#include <Wire.h>

#define MCP4725_ADDR 0x60   
#define TRUE 1
#define FALSE 0


SerialTransfer my_transfer;

struct __attribute__((__packed__)) STRUCT {
  uint16_t intensity;
  uint16_t ramp_time;
  bool ramp;
  bool use_maxwell;
  bool reply;
  bool pulse;
  uint16_t initial_delay;
  uint16_t on_duration;
  uint16_t off_duration;
} position;



// MaxWell Input
int analog_pin = A0; 
int maxwell_toggle = 0;


void delay_ticks(uint16_t ticks){

  for (int i=0; i<ticks; i++){
      delayMicroseconds(50);
  }
  
}


void write_to_DAC(uint16_t value){
   Wire.beginTransmission(MCP4725_ADDR);
   Wire.write(64); // cmd to update the DAC
   Wire.write(value >> 4);             // the 8 most significant bits...
   Wire.write((value & 0b1111) << 4);  // the 4 least significant bits...
   Wire.endTransmission(); 
}


void setup() {

  memset(&position, 0, sizeof(position));

  Serial.begin(115200);
  my_transfer.begin(Serial);

    
   Wire.begin();

  // Set A2 and A3 as Outputs to make them our GND and Vcc,
  //which will power the MCP4725
  pinMode(A2, OUTPUT);
  pinMode(A3, OUTPUT);
  digitalWrite(A2, LOW);//Set A2 as GND
  digitalWrite(A3, HIGH);//Set A3 as Vcc

  //write_to_DAC(0);
     
//  while(!my_transfer.available());
//  my_transfer.rxObj(position); 
//  my_transfer.sendDatum((position));

}


void loop() {

 
     maxwell_toggle = analogRead(analog_pin);

      if (my_transfer.available()) {
          my_transfer.rxObj(position); 
          position.reply = (!(position.use_maxwell)) || (maxwell_toggle > 200);
          position.ramp_time = maxwell_toggle;
          my_transfer.sendDatum((position));
      }

       if((!(position.use_maxwell)) || (maxwell_toggle > 200)){
           write_to_DAC(position.intensity);
      } else {
           write_to_DAC(0);
      }


      
// 
//      if((position.use_maxwell) and (maxwell_toggle > 200)){
//              write_to_DAC(position.intensity);
//      } else if (!(position.use_maxwell) and position.pulse){
//   
//               //write_to_DAC(0);
//              delay(position.initial_delay);//position.initial_delay * 50);
//              
//              write_to_DAC(position.intensity);
//              delay(position.on_duration);//position.on_duration * 50);
//          
//              write_to_DAC(0);
//              delay(position.off_duration);//position.off_duration * 50);
//            
//              position.pulse = FALSE;
//       
//      } else {
//           write_to_DAC(0);
//      }

 
 }




    
